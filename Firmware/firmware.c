/* USER CODE BEGIN Includes */
#include "ssd1306.h"   // Include your OLED library
#include <stdio.h>     // Needed for sprintf
/* USER CODE END Includes */

/* USER CODE BEGIN PV */
uint16_t pot1_value = 0;
uint16_t pot2_value = 0;
volatile uint8_t button_pressed_flag = 0; // 'volatile' is crucial for interrupt variables
/* USER CODE END PV */

/* USER CODE BEGIN 0 */
// This function is automatically called by the HAL when the button is pressed
void HAL_GPIO_EXTI_Callback(uint16_t GPIO_Pin) {
    if(GPIO_Pin == GPIO_PIN_13) { // Replace PIN_13 with your actual button pin
        button_pressed_flag = 1; 
    }
}
/* USER CODE END 0 */

int main(void)
{
  // ... System setup and initialization code generated by CubeMX ...

  /* USER CODE BEGIN 2 */
  // Initialize the OLED screen
  ssd1306_Init();
  ssd1306_Fill(Black);
  ssd1306_SetCursor(2, 0);
  ssd1306_WriteString("STM32 Ready!", Font_7x10, White);
  ssd1306_UpdateScreen();
  /* USER CODE END 2 */

  /* Infinite loop */
  /* USER CODE BEGIN WHILE */
  while (1)
  {
    // 1. Read Potentiometer 1
    HAL_ADC_Start(&hadc1);
    HAL_ADC_PollForConversion(&hadc1, 10);
    pot1_value = HAL_ADC_GetValue(&hadc1);

    // 2. Read Potentiometer 2
    HAL_ADC_Start(&hadc1); 
    HAL_ADC_PollForConversion(&hadc1, 10);
    pot2_value = HAL_ADC_GetValue(&hadc1);
    HAL_ADC_Stop(&hadc1);

    // 3. Update the OLED Screen
    char buffer[32];
    ssd1306_Fill(Black); // Clear screen for new data
    
    // Format and print Pot 1
    sprintf(buffer, "Pot 1: %u", pot1_value);
    ssd1306_SetCursor(2, 0);
    ssd1306_WriteString(buffer, Font_7x10, White);

    // Format and print Pot 2
    sprintf(buffer, "Pot 2: %u", pot2_value);
    ssd1306_SetCursor(2, 15);
    ssd1306_WriteString(buffer, Font_7x10, White);

    // 4. Handle the Button Interrupt
    if (button_pressed_flag) {
        ssd1306_SetCursor(2, 30);
        ssd1306_WriteString("INTERRUPT!", Font_7x10, White);
        
        // Reset the flag so it only triggers once per press
        button_pressed_flag = 0; 
    }

    ssd1306_UpdateScreen();
    HAL_Delay(100); // A small delay stops the screen from flickering
    /* USER CODE END WHILE */
  }
}